## drivers/backlight/aw99703/Kconfig
```kconfig
config LEDS_AW99703
        tristate "AW99703 LED driver"
        default n
        help
         Say Y here if you have a aw99703 compatible
         device connected.

         This driver can also be built as a module.  If so, the module
         will be called leds_aw99703.
```

## drivers/backlight/lm3697/Kconfig
```kconfig
config LEDS_LM3697_MMI
        tristate "LM3697 LED driver"
        default n
        help
         Say Y here if you have a lm3697 compatible
         device connected.

         This driver can also be built as a module.  If so, the module
         will be called leds_lm3697.
```

## drivers/input/misc/chipone_fps_mmi/Kconfig
```kconfig
config INPUT_MISC_CHIPONE_FPS
	tristate "CHIPONE fingerprint sensor MMI"
	default n
	help
	 Say Y here if you wish to include support for MMI CHIPONE finger print sensor.
	 If unsure, say N.
```

## drivers/input/misc/ets_fps_mmi/Kconfig
```kconfig
config INPUT_EGISTEC_FPS
	tristate "Egistec fingerprint sensor MMI"
	default n
	help
	 Say Y here if you wish to include support for MMI EGIS finger print sensor.
	 If unsure, say N.

config INPUT_EGISTEC_FPS_NAVI
	bool "Egistec fingerprint sensor MMI navigation support"
        depends on INPUT_EGISTEC_FPS
	default n
	help
	 Say Y here if you wish to include support for MMI EGIS finger print sensor
         navigation functions.
	 If unsure, say N.

config INPUT_EGISTEC_FPS_NAVI_VERTICAL
	bool "Egistec fingerprint sensor MMI navigation vertical support"
        depends on INPUT_EGISTEC_FPS_NAVI
	default n
	help
	 Say Y here if you wish to include support for MMI EGIS finger print sensor
         vertical navigation functions.
	 If unsure, say N.

config INPUT_EGISTEC_FPS_NAVI_HORIZON
	bool "Egistec fingerprint sensor MMI navigation horizon support"
        depends on INPUT_EGISTEC_FPS_NAVI
	default n
	help
	 Say Y here if you wish to include support for MMI EGIS finger print sensor
         horizon navigation functions.
	 If unsure, say N.

config NAV_DOUBLE_TAP
        bool "Egistec fingerprint sensor MMI double click support"
        depends on INPUT_EGISTEC_FPS
        default n
        help
         Say Y here if you wish to include support for MMI EGIS finger print sensor
         double click functions.
```

## drivers/input/misc/focal_fps_mmi/Kconfig
```kconfig
config INPUT_FOCAL_FPS_MMI
	tristate "FOCAL fingerprint sensor MMI"
	default n
	help
	 Say Y here if you wish to include support for MMI FOCAL finger print sensor.
	 If unsure, say N.
```

## drivers/input/misc/rbs_fps_mmi/Kconfig
```kconfig
config INPUT_EGIS_FPS_MMI
	tristate "EGIS fingerprint sensor MMI"
	default n
	help
	 Say Y here if you wish to include support for MMI EGIS finger print sensor.
	 If unsure, say N.

config ET721_FOD
	bool "FOD Support for egis"
	default n
	depends on INPUT_EGIS_FPS_MMI
	help
	 Say Y here if you wish to include support for MMI EGIS finger print sensor
         FOD support.
	 If unsure, say N.

config EGIS_PANEL_NOTIFICATIONS
	bool "Panel Notification Support for egis"
	default n
	depends on INPUT_EGIS_FPS_MMI
	help
	 Say Y here if you wish to include support for MMI EGIS finger print sensor
         panel notification framework support.
	 If unsure, say N.
```

## drivers/input/misc/vl53L1/Kconfig
```kconfig
config INPUT_STMVL53L1
	tristate "STMVL53L1 support"
	help
	  Say Y here if you wish to include support for laser sensor driver.

config INPUT_MISC_TOF_USE_VL53L3
	bool "STMVL53L3 support"
	depends on INPUT_STMVL53L1
	help
	  Say Y here if you wish to include support for VL53L3 laser sensor driver.
```

## drivers/input/touchscreen/focaltech_v3_mmi/Kconfig
```kconfig
#
# Focaltech Touchscreen driver configuration
#

config TOUCHSCREEN_FOCALTECH_V3_MMI
	tristate "Moto Focaltech Touchscreen"
	depends on I2C
	default n
	help
	  Say Y here if you have Moto Focaltech touch panel.
	  If unsure, say N.

config INPUT_FOCALTECH_MMI_ENABLE_DOUBLE_TAP
	bool "Moto Focaltech Double tap"
	depends on TOUCHSCREEN_FOCALTECH_V2_MMI
	default n
	help
	  Say Y here to enable support for double tap functionality on Focaltech touch panel.
	  If unsure, say N.

config INPUT_FOCALTECH_MMI_IC_FT3519
	bool "Moto Focaltech FT3519"
	depends on TOUCHSCREEN_FOCALTECH_V3_MMI
        default n
        help
          Say Y here to enable support for FT3519 functionality on Focaltech touch panel.
          If unsure, say N.

config INPUT_FOCALTECH_MMI_IC_FT3518U
	bool "Moto Focaltech FT3518U"
	depends on TOUCHSCREEN_FOCALTECH_V3_MMI
        default n
        help
          Say Y here to enable support for FT3518U functionality on Focaltech touch panel.
          If unsure, say N.
```

## drivers/input/touchscreen/himax_v3_mmi/Kconfig
```kconfig
#
# Himax v3 touchscreen driver configuration
#
config TOUCHSCREEN_HIMAX_V3_MMI_0FLASH
	bool "Himax v3 touchpanel CHIPSET"
	depends on SPI_MASTER
	help
	  Say Y here if you have a Himax v3 CHIPSET touchscreen.
	  HIMAX controllers are multi touch controllers which can
	  report 10 touches at a time.

	  If unsure, say N.

config TOUCHSCREEN_HIMAX_V3_SPI
	tristate "HIMAX v3 chipset SPI touchscreen"
	depends on TOUCHSCREEN_HIMAX_V3_MMI_0FLASH
	help
	  This enables support for HIMAX v3 CHIPSET over SPI based touchscreens.

config TOUCHSCREEN_HIMAX_INCELL
	bool "HIMAX chipset in-cell function"
	depends on TOUCHSCREEN_HIMAX_V3_SPI
	help
	  This enables support for HIMAX CHIPSET of in-cell function.

config TOUCHSCREEN_HIMAX_V3_MMI_IC_HX83102D
	bool "HIMAX v3 chipset HX83102D function"
	depends on TOUCHSCREEN_HIMAX_INCELL
	help
	  This enables support for HIMAX v3 CHIPSET of HX83102D.

config TOUCHSCREEN_HIMAX_DEBUG
	bool "HIMAX debug function"
	depends on TOUCHSCREEN_HIMAX_V3_SPI
	help
	  This enables support for HIMAX debug function.

config TOUCHSCREEN_HIMAX_INSPECT
	bool "HIMAX inspect function"
	depends on TOUCHSCREEN_HIMAX_V3_SPI
	help
	  This enables support for HIMAX debug function.

config HMX_DB
	bool "HIMAX driver test over Dragon Board"
	depends on TOUCHSCREEN_HIMAX_V3_SPI
	help
	  This enables support for HIMAX driver test over Dragon Board.

config TOUCHSCREEN_HIMAX_V3_MMI_ENABLE_PALM
	bool "HIMAX inspect function"
	depends on TOUCHSCREEN_HIMAX_V3_SPI
	help
	  This enables support for HIMAX v3 palm function.

config TOUCHSCREEN_HIMAX_V3_MMI_ENABLE_DOUBLE_TAP
	bool "HIMAX inspect function"
	depends on TOUCHSCREEN_HIMAX_V3_SPI
	help
	  This enables support for HIMAX v3 double tap function.

config TOUCHSCREEN_HIMAX_V3_MMI_ENABLE_MULTI_BIN
	bool "HIMAX inspect function"
	depends on TOUCHSCREEN_HIMAX_V3_SPI
	help
	  This enables support for HIMAX v3 multi bin function.
```

## drivers/input/touchscreen/ilitek_0flash_mmi/Kconfig
```kconfig
#
# Ilitek_9882 Touchscreen driver configuration
#

config TOUCHSCREEN_ILITEK_CHIPSET
	tristate "ILITEK Touchscreen"
	default n
	help
	  Say Y here if you have a Moto Novatek NT36xxx no flash touchscreen connected
	  to your system by SPI bus.

	  If unsure, say N.

config INPUT_ILI_0FLASH_MMI_ENABLE_DOUBLE_TAP
	bool "ILITEK Double Tap"
	depends on TOUCHSCREEN_ILITEK_CHIPSET
	default n
	help
	  Say Y here if you want to have Double tap support.

	  If unsure, say N.

config INPUT_ILI_PANEL_NOTIFICATIONS
	bool "ILITEK Panel Notification"
	depends on TOUCHSCREEN_ILITEK_CHIPSET
	default n
	help
	  Say Y here if you want to have panel notification support.

	  If unsure, say N.

config ILITEK_RESUME_BY_DDI
        bool "ILITEK Resume by Display Driver Integration"
        depends on TOUCHSCREEN_ILITEK_CHIPSET
        default n
        help
          Say Y here if you want to have panel notification support.

          If unsure, say N.
```

## drivers/misc/drv2624_mmi/Kconfig
```kconfig
config INPUT_DRV2624_HAPTICS
        tristate "DRV2624 haptic driver"
        depends on I2C
        help
          Say Y here if you have DRV2624 haptic controller
          chip in your system.

          If unsure, say N.

          To compile this driver as a module, choose M here: the
          module will be called drv2624_mmi.
```

## drivers/misc/ldo_vibrator_mmi/Kconfig
```kconfig
config LDO_VIBRATOR_MMI
        tristate "LDO Vibrator driver"
        default n
        help
         Say Y here if you have a ldo vibrator mmi compatible
         device connected.

         This driver can also be built as a module.  If so, the module
         will be called ldo_vibrator_mmi.
```

## drivers/misc/sx933x/Kconfig
```kconfig
#
# SX933X Driver
#

config SARSENSOR_SX933X
	tristate "SX933X sarsensor driver"
	depends on I2C
	help
	  Say Y here if you have SX933X SARSENSOR
	  chip in your system.

	  If unsure, say N.

	  To compile this driver as a module, choose M here: the
	  module will be called sx933x.
```

## drivers/power/bq2589x_chg_mmi/Kconfig
```kconfig
config BQ2589X_CHARGER
        tristate "BQ2589X Charger"
        default n
        help
         Say Y here if you have a bq2589x compatible
         device connected.

         This driver can also be built as a module.  If so, the module
         will be called bq2589x_charger.
```

## drivers/power/bq2597x_mmi_iio/Kconfig
```kconfig
config BQ2597X_MMI_IIO_CHARGER
        tristate "BQ2597X MMI IIO Charger"
        default n
        help
         Say Y here if you have a bq2597x compatible
         device connected.

         This driver can also be built as a module.  If so, the module
         will be called bq2597x_mmi_iio.
```

## drivers/power/cw2217b_fg_mmi/Kconfig
```kconfig
config CW2217B_FG
        tristate "CW2217B Fuel Guage"
        default n
        help
         Say Y here if you have a cw2217b compatible
         device connected.

         This driver can also be built as a module.  If so, the module
         will be called cw2217b_fg.
```

## drivers/power/mmi_discrete_charger/Kconfig
```kconfig
config MMI_DISCRETE_CHARGER
        tristate "MMI Discrete Charger driver"
        default n
        help
         Say Y here if you have a mmi discrete charger compatible
         device connected.

         This driver can also be built as a module.  If so, the module
         will be called mmi_discrete_charger.

config MMI_DISCRETE_CHARGER_CLASS
        tristate "MMI Discrete Charger class driver"
        default n
        help
         Say Y here if you have a mmi discrete charger class compatible
         device connected.

         This driver can also be built as a module.  If so, the module
         will be called mmi_discrete_charger_class.
```

## drivers/power/mmi_discrete_turbo_charger/Kconfig
```kconfig
config MMI_DISCRETE_TURBO_CHARGER
        tristate "MMI Discrete Turbo Charger driver"
        default n
        help
         Say Y here if you have a mmi discrete turbo charger compatible
         device connected.

         This driver can also be built as a module.  If so, the module
         will be called mmi_discrete_turbo_charger.
```

## drivers/power/mmi_qc3p_wt6670f/Kconfig
```kconfig
config MMI_QC3P_WT6670F
        tristate "MMI QC3P WT6670F"
        default n
        help
         Say Y here if you have a qc3p wt6670f compatible
         device connected.

         This driver can also be built as a module.  If so, the module
         will be called mmi_qc3p_wt6670f.
```

## drivers/power/sgm4154x_chg_mmi/Kconfig
```kconfig
config SGM4154X_CHARGER
        tristate "SGM4154X Charger"
        default n
        help
         Say Y here if you have a sgm4154x compatible
         device connected.

         This driver can also be built as a module.  If so, the module
         will be called sgm4154x_charger.
```

## drivers/power/sm5602_fg_mmi/Kconfig
```kconfig
config SM5602_FG
        tristate "SM5602 Fuel Guage driver"
        default n
        help
         Say Y here if you have a SM5602 compatible
         device connected.

         This driver can also be built as a module.  If so, the module
         will be called sm5602_fg_mmi.
```

## drivers/usb/typec/adapter_class/Kconfig
```kconfig
config TYPEC_ADAPTER_CLASS
        tristate "Type-C Adapter Class support"
        default n
        help
         Say Y here if you have a tcpc compatible
         device connected.

         This driver can also be built as a module.  If so, the module
         will be called typec_adapter_class.
```

## drivers/usb/typec/mmi_tcpc/Kconfig
```kconfig
config TCPC_RT1711H
        tristate "TCPC RT1711H driver"
        default n
        depends on TCPC_CLASS
        help
         Say Y here if you have a rt1711h compatible
         device connected.

         This driver can also be built as a module.  If so, the module
         will be called tcpc_rt1711h.

config TCPC_SGM7220
        tristate "TCPC SGM7220 driver"
        default n
        depends on TCPC_CLASS
        help
         Say Y here if you have a sgm7220 compatible
         device connected.

         This driver can also be built as a module.  If so, the module
         will be called tcpc_sgm7220.

config TCPC_CLASS
        tristate "TCPC Class driver"
        default n
        help
         Say Y here if you have a tcpc compatible
         device connected.

         This driver can also be built as a module.  If so, the module
         will be called tcpc_class.

config RT_PD_MANAGER
        tristate "RT PD Manager driver"
        default n
        help
         Say Y here if you have a RT PD compatible
         device connected.

         This driver can also be built as a module.  If so, the module
         will be called rt_pd_manager.
```
